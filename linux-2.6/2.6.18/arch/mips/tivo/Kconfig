## linux-2.6/2.6.18/arch/mips/tivo/Kconfig
```kconfig
config TIVO
	bool "TiVo"
        select ZLIB_INFLATE
        select ZLIB_DEFLATE
	default n
	help
	  Enable TiVo extensions

config TIVO_IRQ_DEBUG
        bool "Support for TiVo IRQ debugging"
        default y
        help    
          TiVo IRQ debugging
	  
config TIVO_DEVEL
	bool "TiVo Devel"
	default n
        select TIVO_CONSDBG
	help
	  Enable TiVo development extensions

config CONTIGMEM
	bool "TiVo Contiguous Memory Driver"
	default n
	help
	  Enable TiVo contiguous memory driver

config TIVO_MOJAVE
	bool "Support for TiVo Mojave"
	default n
	help
	  Enable TiVo HR22 support

config TIVO_KONTIKI
	bool "Support for TiVo Kontiki"
        select BRCM_SKIP_CHECK_BOOTROM
	default n
	help
	  Enable TiVo Kontiki support

config TIVO_NEUTRON
	bool "Support for TiVo Neutron"
        select BRCM_SKIP_CHECK_BOOTROM
        select TIVO_WAR_FOR_BUG303720
	default n
	help
	  Enable TiVo Neutron support

config TIVO_CONSDBG
	bool "Support for TiVo Serial Console Debugging (Shift-Keys)"
	default n
	help
	  Enable TiVo Serial console debugging support

config TIVO_SATA_HOTPLUG
	bool "Support for TiVo style SATA drive hotplug"
	default n
	help
	  Enable TiVo Style SATA drive hotplug
            Application has to poll for the event
            
config TIVO_WATCHDOG
	tristate "Support for TiVo watchdog"
	help
	  Enable TiVo watchdog

config TIVO_PLOG
	bool "Support for TiVo process logger"
	default y
	help
	  Enable TiVo process logger

config TIVO_PANICLOG
	bool "Support for TiVo kernel panic logger"
	default y
	help
	  Enable TiVo kernel panic logger
```

## linux-2.6/2.6.37/arch/x86/tivo/Kconfig
```kconfig
config TIVO_VMTCD
	bool "TiVo VM TCD kernel"
        select ZLIB_INFLATE
        select ZLIB_DEFLATE
	select TIVO_DISKPARTITION
	select TIVO_PLOG
	default n
	help
	  Enable TiVo extensions

config TIVO_DISKPARTITION
	bool "TiVo Disk Parition Map"
	default y
	help
	  Enable TiVo disk partition map

config TIVO_PLOG
	bool "Support for TiVo process logger"
	default y
	help
	  Enable TiVo process logger
```

## linux-3/3.3/arch/mips/tivo/Kconfig
```kconfig
config TIVO
	bool "TiVo"
        select ZLIB_INFLATE
        select ZLIB_DEFLATE
	select TIVO_DISKPARTITION
	default n
	help
	  Enable TiVo extensions

config TIVO_DISKPARTITION
	bool "TiVo Disk Parition Map"
	default y
	help
	  Enable TiVo disk partition map

config TIVO_DEVEL
	bool "TiVo Devel"
	default n
        select TIVO_CONSDBG
	help
	  Enable TiVo development extensions

config CONTIGMEM
	bool "TiVo Contiguous Memory Driver"
	default n
	help
	  Enable TiVo contiguous memory driver

config TIVO_GEN08
    bool "Support for TiVo Gen08"
        select BRCM_SKIP_CHECK_BOOTROM
	default n
	help
	  Enable TiVo Gen08 support (Leo)
    select WEAK_REORDERING_BEYOND_LLSC

config TIVO_GEN10
    bool "Support for TiVo Gen10"
        select BRCM_SKIP_CHECK_BOOTROM
	default n
	help
	  Enable TiVo Gen10 support (Argon/Tarvos)
    select WEAK_REORDERING_BEYOND_LLSC

config TIVO_PAC01
    bool "Support for Pace Pac01"
        select BRCM_SKIP_CHECK_BOOTROM
	default n
	help
	  Enable Pace Pac01 support (Pace XG1, spacely)

config TIVO_PAC02
    bool "Support for PACE Pac02"
        select BRCM_SKIP_CHECK_BOOTROM
    default n
    help
      Enable PACE Pac02 support (Paxe X3, Sprockets)

config TIVO_CONSDBG
	bool "Support for TiVo Serial Console Debugging (Shift-Keys)"
	default n
	help
	  Enable TiVo Serial console debugging support

config TIVO_SATA_HOTPLUG
	bool "Support for TiVo style SATA drive hotplug"
	default n
	help
	  Enable TiVo Style SATA drive hotplug
            Application has to poll for the event
            
config TIVO_WATCHDOG
	bool "Support for Brcm 7429 hardware watchdog"
	default n
	help
	  Enable Brcm 7429 hardware watchdog

config TIVO_PLOG
	bool "Support for TiVo process logger"
	default y
	help
	  Enable TiVo process logger

config TIVO_PANICLOG
	bool "Support for TiVo kernel panic logger"
	default y
	help
	  Enable TiVo kernel panic logger

config TIVO_PANICLOG_IN_RAM
	bool "Support for TiVo kernel panic log in RAM"
	depends on TIVO_PANICLOG
	default n
	help
	  TiVo kernel panic log is stored in RAM between reboots
```

## linux-3/3.3/drivers/mmc/core/Kconfig
```kconfig
#
# MMC core configuration
#

config MMC_UNSAFE_RESUME
	bool "Assume MMC/SD cards are non-removable (DANGEROUS)"
	help
	  If you say Y here, the MMC layer will assume that all cards
	  stayed in their respective slots during the suspend. The
	  normal behaviour is to remove them at suspend and
	  redetecting them at resume. Breaking this assumption will
	  in most cases result in data corruption.

	  This option is usually just for embedded systems which use
	  a MMC/SD card for rootfs. Most people should say N here.

	  This option sets a default which can be overridden by the
	  module parameter "removable=0" or "removable=1".

config MMC_CLKGATE
	bool "MMC host clock gating (EXPERIMENTAL)"
	depends on EXPERIMENTAL
	help
	  This will attempt to aggressively gate the clock to the MMC card.
	  This is done to save power due to gating off the logic and bus
	  noise when the MMC card is not in use. Your host driver has to
	  support handling this in order for it to be of any use.

	  If unsure, say N.

config MMC_FORCE_NO_1V8
	bool "Force no support for 1.8V MMC operation"
	help
	  Do not attempt to use 1.8V mode on cards that claim to support. Use this if
          you know your hardware does not support 1.8V but you controller may claim it does..

          Note that this flag will prevent UHS cards operating in UHS mode.
```
